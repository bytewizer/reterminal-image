## meta-reterminal/conf/machine/reterminal-64.conf
```bitbake
#@TYPE: Machine
#@NAME: reTerminal powered by a Raspberry Pi Compute Module 4 (CM4)
#@DESCRIPTION: Machine configuration for the RaspberryPi 4 in 64 bits mode

PREFERRED_VERSION_linux-raspberrypi ?= "5.10.%"

MACHINEOVERRIDES = "raspberrypi4:${MACHINE}"

MACHINE_FEATURES += "pci wifi bluetooth"
MACHINE_EXTRA_RRECOMMENDS += "\
    linux-firmware-rpidistro-bcm43455 \
    bluez-firmware-rpidistro-bcm4345c0-hcd \
    seeed-linux-dtoverlays \
"

DEFAULTTUNE = "cortexa72"

require conf/machine/include/arm/armv8a/tune-cortexa72.inc
include conf/machine/include/rpi-base.inc

RPI_KERNEL_DEVICETREE = " \
    broadcom/bcm2711-rpi-4-b.dtb \
    broadcom/bcm2711-rpi-400.dtb \
    broadcom/bcm2711-rpi-cm4.dtb \
"

SDIMG_KERNELIMAGE ?= "kernel8.img"
SERIAL_CONSOLES ?= "115200;ttyS0"

UBOOT_MACHINE = "rpi_arm64_config"

VC4DTBO ?= "vc4-kms-v3d"

KERNEL_IMAGETYPE_UBOOT ?= "Image"
KERNEL_IMAGETYPE_DIRECT ?= "Image"
KERNEL_BOOTCMD ?= "booti"

RPI_KERNEL_DEVICETREE_OVERLAYS:append = " \
    overlays/reTerminal.dtbo \
    overlays/i2c3.dtbo \ 
    overlays/vc4-kms-v3d-pi4.dtbo \
"

ARMSTUB ?= "armstub8-gic.bin"

ENABLE_UART = "1"

ENABLE_I2C = "1"
KERNEL_MODULE_AUTOLOAD:rpi += "i2c-dev"

# RPI_EXTRA_CONFIG = " \
#     dtparam=i2c_arm=on \n \
#     dtparam=i2c1=on \n \
#     dtparam=spi=on \n \   
#     enable_uart=1 \n \
#     dtoverlay=vc4-kms-v3d \n \
#     dtoverlay=reTerminal,tp_rotate=1 \n \
#     dtoverlay=i2c3,pins_4_5 \n \
#     dtoverlay=vc4-kms-v3d-pi4 \n \
#     dtoverlay=dwc2,dr_mode=host \n \
#     start_x=1 \n \
# "


do_configure[network] = "1"
```
